## lab4/lab4_3/main/Kconfig.projbuild
```kconfig
menu "HID Example Configuration"
    config EXAMPLE_SSP_ENABLED
        bool "Secure Simple Pairing"
        depends on BT_CLASSIC_ENABLED
        default y
        help
            This enables the Secure Simple Pairing. If disable this option,
            Bluedroid will only support Legacy Pairing

    choice EXAMPLE_HID_DEVICE_ROLE
        prompt "HID Device Role"
        depends on BT_NIMBLE_ENABLED
        default EXAMPLE_MEDIA_ENABLE
        help
            Three Supported Roles for Device
            - Media Device
            - Keyboard
            - Mouse

        config EXAMPLE_MEDIA_ENABLE
            select BT_NIMBLE_HID_SERVICE
            bool "Enable Media Device"

        config EXAMPLE_KBD_ENABLE
            select BT_NIMBLE_HID_SERVICE
            bool "Enable Keyboard Device"

        config EXAMPLE_MOUSE_ENABLE
            select BT_NIMBLE_HID_SERVICE
            bool "Enable Mouse Device"
    endchoice

    config EXAMPLE_HID_DEVICE_ROLE
        int
        default 1 if EXAMPLE_MEDIA_ENABLE
        default 2 if EXAMPLE_KBD_ENABLE
        default 3 if EXAMPLE_MOUSE_ENABLE
endmenu

menu "Example Configuration"

    orsource "$IDF_PATH/examples/common_components/env_caps/$IDF_TARGET/Kconfig.env_caps"

    config I2C_MASTER_SCL
        int "SCL GPIO Num"
        range ENV_GPIO_RANGE_MIN ENV_GPIO_OUT_RANGE_MAX
        default 4
        help
            GPIO number for I2C Master clock line.

    config I2C_MASTER_SDA
        int "SDA GPIO Num"
        range ENV_GPIO_RANGE_MIN ENV_GPIO_OUT_RANGE_MAX
        default 5
        help
            GPIO number for I2C Master data line.

    config I2C_MASTER_FREQUENCY
        int "Master Frequency"
        default 400000
        help
            I2C Speed of Master device.

endmenu
```
